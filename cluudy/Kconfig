## cluudy/Kconfig
```kconfig
config CLOUDYDEV
	tristate "Cloudy Dev KPM (built-in memory read/write)"
	default y
	help
	  Cloudy Dev kernel memory read/write driver.
	  Provides ioctl interface for reading/writing process memory.

	  Features:
	  - Fixed major number 768
	  - No sysfs entries (no /sys/module/cloudydev)
	  - No uevent (no userspace notification)
	  - No exported symbols (hidden from /proc/kallsyms)
	  - Built-in mode: compiled into kernel image

	  Say Y if you want this driver.
	  Say M to build as module (not recommended, use built-in).
	  Say N if you don't need this driver.
```
